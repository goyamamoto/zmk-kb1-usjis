## dts/bindings/behaviors/zmk,behavior-usjis.yaml
```yaml
# SPDX-License-Identifier: MIT

description: US-JIS substitution mode behavior (USJIS_OFF, USJIS_ON, USJIS_TOG)

compatible: "zmk,behavior-usjis"

include: one_param.yaml
```
